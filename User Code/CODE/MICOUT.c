/** ###################################################################
**     THIS BEAN MODULE IS GENERATED BY THE TOOL. DO NOT MODIFY IT.
**     Filename  : MICOUT.C
**     Project   : DC17
**     Processor : MC56F8006_32_LQFP
**     Beantype  : ADC
**     Version   : Bean 01.499, Driver 01.00, CPU db: 3.00.169
**     Compiler  : Metrowerks DSP C Compiler
**     Date/Time : 3/29/2009, 12:01 AM
**     Abstract  :
**         This device "ADC" implements an A/D converter,
**         its control methods and interrupt/event handling procedure.
**     Settings  :
**         AD control register         : ADC1_ADCSC1A [61568]
**         AD control register         : ADC1_ADCSC2 [61569]
**         AD control register         : ADC1_ADCCFG [61574]
**         AD control register         : ADC1_ADCSC1B [61578]
**         AD control register         : ADC1_ADCRA  [61579]
**         AD control register         : ADC1_ADCRB  [61580]
**         User handling procedure     : not specified
**         Number of conversions       : 1
**         AD resolution               : 12-bit
**
**         Input pins
**
**              Port name              : GPIOC
**              Bit number (in port)   : 4
**              Bit mask of the port   : 16
**              Port data register     : GPIO_C_DR   [61889]
**              Port control register  : GPIO_C_DDR  [61890]
**              Port function register : GPIO_C_PER  [61891]
**
**         Initialization:
**              Conversion             : Enabled
**              Event                  : Enabled
**         High speed mode
**             Prescaler               : divide-by-1
**     Contents  :
**         Enable     - byte MICOUT_Enable(void);
**         Disable    - byte MICOUT_Disable(void);
**         Measure    - byte MICOUT_Measure(bool WaitForResult);
**         GetValue16 - byte MICOUT_GetValue16(word *Values);
**
**     (c) Copyright UNIS, a.s. 1997-2008
**     UNIS, a.s.
**     Jundrovska 33
**     624 00 Brno
**     Czech Republic
**     http      : www.processorexpert.com
**     mail      : info@processorexpert.com
** ###################################################################*/


/* MODULE MICOUT. */

#include "MICOUT.h"

static void SaveValue(void);
/*
** ===================================================================
**     Method      :  SaveValue (bean ADC)
**
**     Description :
**         This method is internal. It is used by Processor Expert only.
** ===================================================================
*/
static void MICOUT_MainMeasure(void);
/*
** ===================================================================
**     Method      :  MainMeasure (bean ADC)
**
**     Description :
**         The method performs A/D conversion(s). The method is called 
**         automatically as a part of measure methods or the HWEnDi 
**         method.
**         This method is internal. It is used by Processor Expert only.
** ===================================================================
*/
#define STOP            0              /* STOP state           */
#define MEASURE         1              /* MESURE state         */
#define CONTINUOUS      2              /* CONTINUOS state      */
#define SINGLE          3              /* SINGLE state         */


static const byte Channels = 8;        /* Content for the device control register */

static bool EnUser;                    /* Enable/Disable device */
static bool OutFlg;                    /* Measurement finish flag */
static byte ModeFlg;                   /* Current state of device */

word MICOUT_OutV;                      /* Sum of measured values */


bool WaitForRes;                       /* Wait for result flag */


/*
** ===================================================================
**     Method      :  SaveValue (bean ADC)
**
**     Description :
**         This method is internal. It is used by Processor Expert only.
** ===================================================================
*/
static void SaveValue(void)
{
  MICOUT_OutV = getReg16(ADC1_ADCRA);  /* Save measured value */
  OutFlg = TRUE;                       /* Measured values are available */
  ModeFlg = STOP;                      /* Set the device to the stop mode */
}

/*
** ===================================================================
**     Method      :  MainMeasure (bean ADC)
**
**     Description :
**         The method performs A/D conversion(s). The method is called 
**         automatically as a part of measure methods or the HWEnDi 
**         method.
**         This method is internal. It is used by Processor Expert only.
** ===================================================================
*/
static void MICOUT_MainMeasure(void)
{

  ADC1_ADCSC1A = Channels;             /* Start measurement of next channel */
  if (!WaitForRes) {                   /* If doesn't wait for result */
    return;                            /* then return */
  }
  while (!testReg16Bit(ADC1_ADCSC1A, COCO)) {} /* Wait for AD conversion complete */
  MICOUT_OutV = getReg16(ADC1_ADCRA);  /* Save measured value */
  OutFlg = TRUE;                       /* Measured values are available */
  SaveValue();
}
/*
** ===================================================================
**     Method      :  MICOUT_HWEnDi (bean ADC)
**
**     Description :
**         Enables or disables the peripheral(s) associated with the bean.
**         The method is called automatically as a part of the Enable and 
**         Disable methods and several internal methods.
**         This method is internal. It is used by Processor Expert only.
** ===================================================================
*/
void MICOUT_HWEnDi(void)
{
  if (EnUser) {                        /* Enable device? */
    if (ModeFlg) {                     /* Start or stop measurement? */
      OutFlg = FALSE;                  /* Output value isn't available */
      MICOUT_MainMeasure();
    }
  }
  else {
    setReg16(ADC1_ADCSC1A, 31);        /* Disable the device */
  }
}

/*
** ===================================================================
**     Method      :  MICOUT_Enable (bean ADC)
**
**     Description :
**         Enables A/D converter bean. <Events> may be generated
**         (<DisableEvent>/<EnableEvent>). If possible, this method
**         switches on A/D converter device, voltage reference, etc.
**     Parameters  : None
**     Returns     :
**         ---             - Error code, possible codes:
**                           ERR_OK - OK
**                           ERR_SPEED - This device does not work in
**                           the active speed mode
** ===================================================================
*/
byte MICOUT_Enable(void)
{
  if (EnUser) {                        /* Is the device enabled by user? */
    return ERR_OK;                     /* If yes then set the flag "device enabled" */
  }
  EnUser = TRUE;                       /* Set the flag "device enabled" */
  MICOUT_HWEnDi();                     /* Enable the device */
  return ERR_OK;                       /* OK */
}

/*
** ===================================================================
**     Method      :  MICOUT_Disable (bean ADC)
**
**     Description :
**         Disables A/D converter bean. No <events> will be generated.
**         If possible, this method switches off A/D converter device,
**         voltage reference, etc.
**     Parameters  : None
**     Returns     :
**         ---             - Error code, possible codes:
**                           ERR_OK - OK
**                           ERR_SPEED - This device does not work in
**                           the active speed mode
** ===================================================================
*/
byte MICOUT_Disable(void)
{
  if (!EnUser) {                       /* Is the device disabled by user? */
    return ERR_OK;                     /* If yes then OK */
  }
  EnUser = FALSE;                      /* If yes then set the flag "device disabled" */
  MICOUT_HWEnDi();                     /* Enable the device */
  return ERR_OK;                       /* OK */
}

/*
** ===================================================================
**     Method      :  MICOUT_Measure (bean ADC)
**
**     Description :
**         This method performs one measurement on all channels that
**         are set in the bean inspector. (Note: If the <number of
**         conversions> is more than one the conversion of A/D channels
**         is performed specified number of times.)
**     Parameters  :
**         NAME            - DESCRIPTION
**         WaitForResult   - Wait for a result of a
**                           conversion. If <interrupt service> is
**                           disabled, A/D peripheral doesn't support
**                           measuring all channels at once or Autoscan
**                           mode property isn't enabled and at the same
**                           time the <number of channel> is greater
**                           than 1, then the WaitForResult parameter is
**                           ignored and the method waits for each
**                           result every time. If the <interrupt
**                           service> is disabled and a <number of
**                           conversions> is greater than 1, the
**                           parameter is ignored and the method also
**                           waits for each result every time.
**     Returns     :
**         ---             - Error code, possible codes:
**                           ERR_OK - OK
**                           ERR_SPEED - This device does not work in
**                           the active speed mode
**                           ERR_DISABLED - Device is disabled
**                           ERR_BUSY - A conversion is already running
** ===================================================================
*/
byte MICOUT_Measure(bool WaitForResult)
{
  if (!EnUser) {                       /* Is the device disabled by user? */
    return ERR_DISABLED;               /* If yes then error */
  }
  if (ModeFlg != STOP) {               /* Is the device in different mode than "stop"? */
    return ERR_BUSY;                   /* If yes then error */
  }
  ModeFlg = MEASURE;                   /* Set state of device to the measure mode */
  WaitForRes = WaitForResult;          /* Save Wait for result flag */
  MICOUT_HWEnDi();                     /* Enable the device */
  return ERR_OK;                       /* OK */
}

/*
** ===================================================================
**     Method      :  MICOUT_GetValue16 (bean ADC)
**
**     Description :
**         This method returns the last measured values of all channels
**         justified to the left. Compared with <GetValue> method this
**         method returns more accurate result if the <number of
**         conversions> is greater than 1 and <AD resolution> is less
**         than 16 bits. In addition, the user code dependency on <AD
**         resolution> is eliminated.
**     Parameters  :
**         NAME            - DESCRIPTION
**       * Values          - Pointer to the array that contains
**                           the measured data.
**     Returns     :
**         ---             - Error code, possible codes:
**                           ERR_OK - OK
**                           ERR_SPEED - This device does not work in
**                           the active speed mode
**                           ERR_NOTAVAIL - Requested value not
**                           available
**                           ERR_OVERRUN - External trigger overrun flag
**                           was detected after the last value(s) was
**                           obtained (for example by GetValue). This
**                           error may not be supported on some CPUs
**                           (see generated code).
** ===================================================================
*/
byte MICOUT_GetValue16(word *Values)
{
  if (!OutFlg) {                       /* Is output flag set? */
    if (testReg16Bit(ADC1_ADCSC1A, COCO)) {
      SaveValue();                     /* Save measured value, finish measuring */
    }
    else {
      return ERR_NOTAVAIL;             /* If no then error */
    }
  }
  *Values = (MICOUT_OutV) << 1;        /* Save measured values to the output buffer */
  return ERR_OK;                       /* OK */
}

/*
** ===================================================================
**     Method      :  MICOUT_Init (bean ADC)
**
**     Description :
**         Initializes the associated peripheral(s) and the beans 
**         internal variables. The method is called automatically as a 
**         part of the application initialization code.
**         This method is internal. It is used by Processor Expert only.
** ===================================================================
*/
void MICOUT_Init(void)
{
  EnUser = TRUE;                       /* Enable device */
  OutFlg = FALSE;                      /* No measured value */
  ModeFlg = STOP;                      /* Device isn't running */
  /* ADC1_ADCSC1B: ??=0,??=0,??=0,??=0,??=0,??=0,??=0,??=0,COCO=0,AIEN=0,ADCO=0,ADCH=31 */
  setReg16(ADC1_ADCSC1B, 31);          /* Disable the module */ 
  /* ADC1_ADCSC2: ??=0,??=0,??=0,??=0,??=0,??=0,??=0,??=0,ADACT=0,ADTRG=0,??=0,??=0,??=0,ECC=0,REFSEL=1 */
  setReg16(ADC1_ADCSC2, 1);            /* Disable HW trigger */ 
  /* ADC1_ADCCFG: ??=0,??=0,??=0,??=0,??=0,??=0,??=0,??=0,ADLPC=1,ADIV=0,ADLSMP=0,MODE=1,ADICLK=3 */
  setReg16(ADC1_ADCCFG, 135);          /* Set prescaler bits */ 
  /* ADC1_ADCSC1A: ??=0,??=0,??=0,??=0,??=0,??=0,??=0,??=0,COCO=0,AIEN=0,ADCO=0,ADCH=31 */
  setReg16(ADC1_ADCSC1A, 31);          /* Disable the module */ 
  MICOUT_HWEnDi();                     /* Enable/disable device according to the status flags */
}


/* END MICOUT. */

/*
** ###################################################################
**
**     This file was created by UNIS Processor Expert 2.99 [04.17]
**     for the Freescale 56800 series of microcontrollers.
**
** ###################################################################
*/
